## boards/arm/ms88sf2/Kconfig
```kconfig
# MS88SF2 board configuration
#
# Copyright (c) 2022 Konstantin Selin
# Copyright (c) 2016 Nordic Semiconductor ASA
#
# SPDX-License-Identifier: MIT-Modern-Variant
#
if BOARD_MS88SF2

config BOARD_ENABLE_DCDC
	bool "DCDC mode"
	select SOC_DCDC_NRF52X
	default y

config BOARD_ENABLE_DCDC_HV
	bool "High Voltage DCDC converter"
	select SOC_DCDC_NRF52X_HV
	default y

endif # BOARD_MS88SF2
```

## boards/arm/ms88sf2/Kconfig.board
```kconfig
# nRF52840 DK NRF52840 board configuration
#
# Copyright (c) 2022 Konstantin Selin
# Copyright (c) 2016 Nordic Semiconductor ASA
#
# SPDX-License-Identifier: MIT-Modern-Variant
#
config BOARD_MS88SF2
	bool "MS88SF2"
	depends on SOC_NRF52840_QIAA
```

## boards/arm/ms88sf2/Kconfig.defconfig
```kconfig
# MS88SF2 board configuration
#
# Copyright (c) 2022 Konstantin Selin
# Copyright (c) 2016 Nordic Semiconductor ASA
#
# SPDX-License-Identifier: MIT-Modern-Variant
#
if BOARD_MS88SF2

config BOARD
	default "ms88sf2"

config BT_CTLR
   default BT

endif # BOARD_MS88SF2
```
